## firmware/main/Kconfig.projbuild
```kconfig
menu "HID bridge (application configuration)"

    config APP_ENABLE_HID_HOST
        bool "Central role: receive reports from a BLE keyboard and mouse"
        depends on !APP_ROLE_FAKE_KEYBOARD
        default y
        help
            Enables the BLE scanner and esp_hidh (GATT client). Can be turned off to
            test the pad side alone, without scanning competing for antenna time.

    config APP_ENABLE_GAMEPAD
        bool "Peripheral role: present a HID gamepad to the PC"
        depends on !APP_ROLE_FAKE_KEYBOARD
        default y
        help
            Enables our own GATT server with HID service 0x1812 and advertising.

    choice APP_GAMEPAD_PROFILE
        prompt "Pad: profile the PC sees"
        depends on APP_ENABLE_GAMEPAD
        default APP_GAMEPAD_PROFILE_XBOX
        help
            Decides what the pad claims to be.

            NOTE: switching the profile changes the report descriptor AND the device
            identity, so it requires removing the pad from the Windows Bluetooth
            device list and pairing again (AGENTS.md 4.7).

        config APP_GAMEPAD_PROFILE_GENERIC
            bool "Generic HID pad (DirectInput, visible in joy.cpl)"
            help
                4 signed 8-bit axes + 12 buttons, with our own VID/PID.
                Games that only speak XInput will NOT see this pad.
                This is the profile verified first - kept as a fallback.

        config APP_GAMEPAD_PROFILE_XBOX
            bool "Xbox Series X pad (XInput)"
            help
                The bridge impersonates a wireless Xbox Series X controller (model
                1914): the report descriptor is byte-for-byte that of a real pad, and
                the PnP ID carries Microsoft's VID with PID 0x0B13. Windows then loads
                its own driver and exposes the device through XInput.

                The PID is not arbitrary - xinputhid.inf binds only to 0x0B13 and
                0x0B20..0x0B27, see AGENTS.md 4.32.

                Axes are 16-bit, triggers 10-bit, and there is a hat switch plus 15
                buttons. Input mapping details: AGENTS.md 4.31.
    endchoice

    config APP_GAMEPAD_SELFTEST
        bool "Pad: synthetic test pattern instead of real inputs"
        depends on APP_ENABLE_GAMEPAD
        default n
        help
            Instead of mapping the keyboard and mouse, the pad sweeps its left stick
            around a circle and presses buttons in turn. Lets you verify in joy.cpl
            that the report descriptor is correct without connecting any input device.

    config APP_GAMEPAD_DEVICE_NAME
        string "Pad: name advertised over BLE"
        depends on APP_ENABLE_GAMEPAD
        default "Xbox Wireless Controller" if APP_GAMEPAD_PROFILE_XBOX
        default "C3 Gamepad"
        help
            The name shown in the Windows Bluetooth device list. Changing the name does
            not require re-pairing, unlike changing the report descriptor.

            In the Xbox profile it defaults to what a real pad uses - Windows shows it
            in the Bluetooth settings, and when impersonating a device there is no
            reason for it to differ.

    config APP_PAD_CONN_ITVL
        int "Pad: target connection interval to the PC [units of 1.25 ms]"
        depends on APP_ENABLE_GAMEPAD
        range 6 40
        default 6
        help
            Interval of the pad -> PC link. This is the NARROWEST POINT of the whole
            chain: the mouse can report as often as it likes, but only what fits through
            this link reaches the game.

            We do not set this interval ourselves - Windows is the central on this link
            and it picks the value. A peripheral can only ASK for a change, through the
            LL Connection Parameters Request procedure or L2CAP. Windows may refuse.

            The default of 6 (7.5 ms = 133 Hz) follows from a real Xbox pad doing 125 Hz
            over BT - so Windows is clearly able to hold such a link. The firmware walks
            a ladder from this value and logs what it managed to get.

    config APP_REPORT_RATE_HZ
        int "Pad: report task frequency [Hz]"
        depends on APP_ENABLE_GAMEPAD || APP_USB_PAD
        range 10 1000
        default 100
        help
            The task wakes up at this rate, but a report is only sent to the PC when the
            pad state has actually changed.

            TWO THINGS BOUND THIS FROM ABOVE, and both fail quietly rather than loudly.

            First, the FreeRTOS tick: pdMS_TO_TICKS() rounds DOWN to whole ticks, so a rate
            faster than CONFIG_FREERTOS_HZ collapses to one report per tick. Measured: 250 Hz
            with the default 100 Hz tick gave 97 Hz, below what the BLE build manages. The
            mapper logs the rate it actually achieves and warns when the requested one is
            unreachable, so read that line instead of trusting this number.

            Second, on USB the pad cannot beat its endpoint interval
            (APP_XINPUT_EP_INTERVAL_MS): 4 ms means 250 Hz however fast this task runs.

            The upper bound is 1000 because 1 ms is the floor for a Full Speed interrupt
            endpoint and the ESP32-S3's USB-OTG is Full Speed only. Note that a value above the
            range is NOT clamped - kconfig discards it and silently substitutes the default of
            100, which is worth knowing before wondering where a setting went.

    config APP_INPUT_CONN_ITVL
        int "Inputs: target connection interval [units of 1.25 ms]"
        depends on APP_ENABLE_HID_HOST
        range 6 40
        default 12
        help
            Upper limit on the report rate from the keyboard and mouse. A peripheral can
            only send a notification during a connection event, so the interval decides
            everything - even a mouse with a high polling rate cannot send more.

            Value in units of 1.25 ms:
              6  = 7.5 ms  -> 133 Hz  (minimum allowed by the BLE spec)
              8  = 10 ms   -> 100 Hz
              12 = 15 ms   ->  66 Hz  (default; also what Windows negotiates for the pad)
              24 = 30 ms   ->  33 Hz
              36 = 45 ms   ->  22 Hz  (what we got before this was implemented)

            MEASURED ON HARDWARE: the C3 controller REJECTS intervals of 7.5 / 10 /
            12.5 ms with HCI error 0x12 and accepts 15 ms. Verified that neither ce_len
            nor the supervision timeout is the cause - the same values with those changed
            were rejected too. Details in AGENTS.md 4.33.

            Leaving a smaller value here does no harm: the firmware walks a ladder and
            uses the shortest interval the controller accepts. The log shows each attempt.

    config APP_HID_WANT_KEYBOARD
        bool "Central: accept keyboards"
        depends on APP_ENABLE_HID_HOST
        default y
        help
            Turn this off on a chip that is only meant to serve the mouse. Candidates
            advertising the keyboard appearance (0x03C1) are then skipped before we even
            try to connect, and a device that opens with no keyboard reports is closed.

            Used by the split bridge on the ESP Thread BR board: the H2 wants the mouse
            only, the S3 wants the keyboard only.

    config APP_HID_WANT_MOUSE
        bool "Central: accept mice"
        depends on APP_ENABLE_HID_HOST
        default y
        help
            Mirror of the option above. Note that our test keyboard also declares a mouse
            report (its Fn layer emulates a mouse - AGENTS.md 4.16), so this flag alone
            cannot tell the two devices apart; the advertised appearance does that.

    choice APP_LINK_MODE
        prompt "Inter-chip link over UART (split bridge)"
        default APP_LINK_DISABLED
        help
            Splits the bridge across the two SoCs of an ESP Thread Border Router board,
            which wires its ESP32-S3 and ESP32-H2 together with UART and SPI.

            The point is not link speed - a mouse report crosses at 921600 baud in about
            0.1 ms, two orders of magnitude below the 15 ms BLE connection interval. The
            point is RADIO time: each chip then serves fewer links, instead of one radio
            interleaving keyboard, mouse and pad.

        config APP_LINK_DISABLED
            bool "Disabled: one chip does everything"

        config APP_LINK_RECEIVER
            bool "Receiver (host chip: keyboard + pad, mouse arrives over UART)"

        config APP_LINK_SENDER
            bool "Sender (satellite chip: mouse only, forwarded over UART)"
    endchoice

    config APP_LINK_UART_PORT
        int "Link: UART port number"
        depends on !APP_LINK_DISABLED
        range 1 2
        default 1
        help
            Deliberately NOT port 0. On the H2 the link lands on GPIO23/24, which are that
            chip's default UART0 pins, and UART0 is where the ROM bootloader prints. Using
            UART1 over the GPIO matrix keeps the ROM chatter out of our driver; the framing
            would survive it anyway, but there is no reason to invite it.

    config APP_LINK_TX_GPIO
        int "Link: TX pin (-1 when this side never transmits)"
        depends on !APP_LINK_DISABLED
        default 24 if IDF_TARGET_ESP32H2
        default -1
        help
            MEASURED ON HARDWARE, not taken from a datasheet. The ESP Thread BR board's
            internal S3-to-H2 wiring is not in the docs we could find - ESP-IDF's ot_br
            example hardcodes GPIO4/5, but its README shows that as DevKit-to-DevKit
            wiring, and on this board it is wrong. So the firmware swept its own input
            pins while the other chip kept sending (APP_LINK_PROBE_RX):

              S3 GPIO17  <--- H2 GPIO24 (U0TXD)    proven: 4 CRC-valid frames per second
                                                   against a 250 ms keepalive

            The link is one-directional, so the host chip does not transmit at all and its
            TX stays -1 - no reason to drive a net whose other end we never verified. The
            S3 counterpart of the H2's RX is most likely GPIO18, by adjacency, but that is
            a guess and nothing depends on it.

    config APP_LINK_RX_GPIO
        int "Link: RX pin (-1 when this side never receives)"
        depends on !APP_LINK_DISABLED
        default 17 if IDF_TARGET_ESP32S3
        default -1

    config APP_LINK_BAUD
        int "Link: baud rate"
        depends on !APP_LINK_DISABLED
        range 115200 3000000
        default 921600
        help
            921600 puts a 10-byte mouse frame on the wire in ~108 us. Raising it further
            buys nothing measurable; lower it first if the link ever shows CRC errors.

    config APP_LINK_PEER_TIMEOUT_MS
        int "Link: treat the peer as gone after this long without a frame [ms]"
        depends on APP_LINK_RECEIVER
        range 200 10000
        default 1500
        help
            The sender emits a keepalive frame even when the mouse is still, so silence
            means the peer really is gone. On timeout the receiver clears the mouse state,
            otherwise a button held at the moment the link died would stay held forever.

    config APP_LINK_PROBE_RX
        bool "Link diagnostics: sweep candidate RX pins to find the peer"
        depends on APP_LINK_RECEIVER
        default n
        help
            Instead of receiving, walk a list of GPIOs and report how many bytes and how
            many valid frames arrive on each. Use it when the wiring between the two chips
            is not documented: the sender emits a keepalive every 250 ms, so a second per
            pin is enough to tell.

            Only ever configures a pin as UART RX, i.e. as an input, so it cannot fight
            whatever else is driving that net. The USB pins (S3 GPIO19/20) are excluded
            because the console runs on them.

    config APP_USB_PAD
        bool "USB device role: present an XInput gamepad over USB"
        depends on SOC_USB_OTG_SUPPORTED
        depends on !APP_ROLE_FAKE_KEYBOARD
        default n
        help
            Presents an Xbox 360 wired controller (VID 0x045E, PID 0x028E) over USB, which is
            what makes Windows load its XInput driver. Read off this machine's
            C:\Windows\INF\xusb22.inf, the match is on VID/PID alone.

            NOT the same trick as the BLE profile. xinputhid.inf, which binds our BLE pad,
            has zero USB entries - so a USB HID device with PID 0x0B13 gets the generic
            driver instead. USB XInput is a vendor-specific interface with two interrupt
            endpoints and no report descriptor at all.

            Mutually exclusive with APP_ENABLE_GAMEPAD: one pad transport at a time. The
            build stops with an #error if both are on.

            Note that the console cannot stay on USB Serial/JTAG here: that peripheral and
            USB-OTG share GPIO19/20 on the S3, so the console has to move to UART.

    config APP_USB_HID_HOST
        bool "USB host role: read a keyboard and a mouse over USB"
        depends on SOC_USB_OTG_SUPPORTED
        depends on !APP_ROLE_FAKE_KEYBOARD
        default n
        help
            Runs the USB host stack and the HID class driver, so a keyboard and a mouse can be
            attached - through a hub, which needs USB_HOST_HUBS_SUPPORTED.

            Mutually exclusive with APP_ENABLE_HID_HOST (the BLE central role): the two would
            both claim to be the source of input state.

            Same console caveat as above.

    config APP_XINPUT_EP_INTERVAL_MS
        int "USB pad: IN endpoint polling interval [ms]"
        depends on APP_USB_PAD
        range 1 8
        default 4
        help
            How often the host asks the pad for a report. 4 ms (250 Hz) is what a real Xbox 360
            wired controller declares, and it is the default because the rest of the descriptor
            is copied from that controller byte for byte.

            SETTING 1 BREAKS THAT BYTE-FOR-BYTE MATCH. It is safe as far as driver binding goes -
            xusb22.inf matches on VID/PID alone and never looks at the descriptor - but it is a
            structural deviation from the device we impersonate, and scripts/check_xinput_
            descriptor.py will report it rather than pass silently.

            1 ms is the floor for a Full Speed interrupt endpoint, and the ESP32-S3's USB-OTG is
            Full Speed only, so 1 kHz is both the target and the ceiling here; the 8 kHz that
            some mice manage natively needs High Speed microframes, which this chip does not have.

            Raising the rate is only useful together with APP_REPORT_RATE_HZ, and that in turn
            needs a FreeRTOS tick fast enough to express the period - see the mapper's startup
            log, which states the rate it actually achieves.

    config APP_USB_PASSTHROUGH
        bool "USB: hotkey switches between the pad and plain keyboard+mouse"
        depends on APP_USB_PAD || APP_USB_HID_HOST
        default y
        help
            A key combination toggles the pad chip between two USB identities: the XInput pad,
            and a plain HID keyboard plus mouse that passes the real devices through to the PC.

            WHY IT HAS TO BE TWO IDENTITIES rather than one composite device. xusb22 binds at
            DEVICE level, not per interface - the real Xbox 360 pad has four interfaces and the
            driver owns all of them. Adding keyboard and mouse interfaces under the same VID/PID
            would hand them to xusb22 as well, and Windows would never see a keyboard. So the
            chip disconnects, swaps its descriptors and re-enumerates; the pad disappears while
            passthrough is active, which is the accepted cost of the feature.

            Both chips need this enabled: the input chip detects the combination and sends it
            over the link, the pad chip performs the switch.

    config APP_PASSTHROUGH_KEYCODE
        hex "Passthrough hotkey: USB HID keycode pressed with Ctrl+Alt"
        depends on APP_USB_PASSTHROUGH
        default 0x0A
        help
            USB HID Keyboard/Keypad usage ID of the key that toggles passthrough when held
            together with Ctrl and Alt (either side of the keyboard counts).

            0x0A is G. Values worth knowing: 0x04..0x1D are A..Z in alphabetical order, so
            0x0A = G, 0x11 = N, 0x15 = R. The combination is consumed rather than passed on, so
            whatever is chosen here never reaches the PC as a keystroke.

            Ctrl+Alt was picked because both modifiers are visible in the boot-protocol report
            and the pair is rare in games, where a stray toggle would be costly.

    config APP_WEBUI
        bool "Web configuration panel over Wi-Fi"
        depends on (APP_USB_PAD && SOC_WIFI_SUPPORTED) || APP_LINK_SENDER
        default n
        help
            Serves a configuration panel over Wi-Fi: mouse sensitivity, the smoothing time
            constant, deadzone compensation, the key-to-control mapping, profiles and firmware
            updates. Without it those live in Kconfig, which means a rebuild and a reflash to
            change a number you can only judge by feel.

            ENABLE IT ON BOTH CHIPS, like passthrough, because the two ends do different jobs:

              - the PAD chip runs Wi-Fi, the HTTP server and the configuration store, because
                that is where the mapper and the settings it reads already live;
              - the INPUT chip only detects the hotkeys and reports them over the link, because
                that is where the keyboard is.

            Enabled on just the pad chip, the panel works but no hotkey can reach it. Enabled on
            just the input chip, the hotkeys are detected and nothing listens.

            WI-FI IS OFF UNTIL ASKED FOR. It is brought up by the hotkey below and shut down
            again after an idle timeout, so nothing competes with the 1 kHz report path while a
            game is running. That is what makes the feature free rather than a trade-off, and it
            is why the measured 997 Hz ceiling stays meaningful.

    config APP_WEBUI_HOTKEY_KEYCODE
        hex "Web panel hotkey: USB HID keycode pressed with Ctrl+Alt"
        depends on APP_WEBUI
        default 0x1A
        help
            Toggles Wi-Fi and the panel on and off. 0x1A is W. Like the passthrough hotkey the
            combination is consumed, so it never reaches the PC.

            W is bound to the left stick in the default mapping, which does not clash in
            practice: the stick only misses the keystroke while Ctrl and Alt are both held, and
            that combination was chosen precisely because it is rare in games.

    config APP_WEBUI_AP_HOTKEY_KEYCODE
        hex "Force access point mode: USB HID keycode pressed with Ctrl+Alt"
        depends on APP_WEBUI
        default 0x13
        help
            Forces the bridge to serve its own access point instead of joining a stored network,
            and brings Wi-Fi up if it was off. 0x13 is P, as in access Point.

            This exists because the useful failure mode is silent: if the stored network is out
            of range, or its password changed, or the router hands out an address you cannot
            guess, then "join the network" leaves the panel unreachable and there is nothing to
            configure it with. One keystroke on the keyboard the bridge already owns is the way
            back in that does not need a serial adapter.

    config APP_WEBUI_AP_SSID_PREFIX
        string "Access point name prefix"
        depends on APP_WEBUI
        default "hid-bridge"
        help
            The last two bytes of the chip's MAC address are appended, so two bridges on one
            bench do not collide and the name identifies the board.

    config APP_WEBUI_PASSWORD
        string "Device password (empty = derive one from the MAC address)"
        depends on APP_WEBUI
        default ""
        help
            Used both as the WPA2 key of the access point and as the password the panel asks
            for. Left empty, a value is derived from the MAC address and printed in the console
            at startup: unique per board, nothing to configure, and not a shared secret that
            every clone of this repository would have.

            THIS IS NOT OPTIONAL HARDENING. The panel can change what the pad reports and can
            flash new firmware, so an unauthenticated one would let anyone in range move your
            sticks mid-game or replace the firmware outright. WPA2 protects the air on the
            access point; the password protects against someone already on the network when the
            bridge has joined yours instead.

            Must be at least 8 characters, which is a WPA2 requirement, not ours.

    config APP_WEBUI_IDLE_TIMEOUT_MIN
        int "Shut Wi-Fi down after this many minutes without a request (0 = never)"
        depends on APP_WEBUI
        range 0 120
        default 10
        help
            Counted from the last HTTP request, so an open panel keeps itself alive. The point is
            that forgetting to switch Wi-Fi off should not quietly cost radio time and CPU for
            the rest of the session.

    config APP_WEBUI_STA_TIMEOUT_S
        int "Seconds to wait for a stored network before falling back to the access point"
        depends on APP_WEBUI
        range 5 60
        default 15
        help
            When credentials are stored the bridge tries to join that network first and drops the
            access point once it succeeds - which is what makes the panel reachable at a stable
            address from a phone that is already on your Wi-Fi. If the join does not happen
            within this many seconds it serves its own access point instead, so there is always
            something to connect to.

    config APP_DEBUG_PAD_RATE_PROBE
        bool "Diagnostics: force a different pad report every tick, to measure the transport"
        depends on APP_ENABLE_GAMEPAD || APP_USB_PAD
        default n
        help
            Makes the mapper alter one axis by one unit on every tick, so consecutive reports
            are never identical.

            WHY THIS IS NEEDED. A pad report is only sent when the state CHANGES, so counting
            XInput packets measures three things at once: how fast the device can send, how often
            the mapped value actually differs, and how vigorously somebody is moving the mouse.
            The three cannot be separated afterwards - measurements of 243, 153 and 124 Hz across
            three configurations turned out to say more about the smoothing filter and the hand
            than about USB.

            With this option every tick produces a distinct report, so scripts/xinput_rumble.py
            --rate measures the transport alone: the endpoint interval, the task rate and
            whatever the host driver is willing to forward.

            The pad is unusable while this is on - one axis jitters by a single unit
            continuously. It is a measuring instrument, not a feature.

    config APP_MOUSE_SCALE_DIV
        int "Mapping: mouse sensitivity divisor"
        depends on (APP_ENABLE_GAMEPAD && APP_ENABLE_HID_HOST) || APP_USB_PAD
        range 1 512
        default 24
        help
            The larger the value, the less sensitive the mouse. Full axis deflection corresponds
            to a mouse speed of (this value * 400) COUNTS PER SECOND - per second, not per task
            tick, so the feel no longer changes when APP_REPORT_RATE_HZ does. It used to be
            per-tick, and raising the report rate then quietly made the mouse less sensitive.

            At the default of 24 that is 9600 counts/s. Where the number comes from: measurements
            showed up to ~355 counts per report during brisk movement with reports every ~45 ms,
            i.e. ~7900 counts/s, so it lands around 80 % of the range. With the earlier default
            of 8 the stick hit maximum almost immediately.

            HIGH-DPI MICE NEED MORE. 9600 counts/s is one flick of the wrist at 3200 DPI, and on
            the USB pad - which runs at 1 kHz and no longer throws away resolution in the filter -
            that pegs the stick constantly. sdkconfig.defaults.s3pad therefore raises it. Treat
            the value as a taste parameter and expect to try a few; the upper bound is generous
            rather than tight, because the useful setting depends on mouse DPI, which the firmware
            cannot know.

            The change only requires a rebuild - re-pairing the pad is NOT needed, because the
            descriptor does not change.

    config APP_ROLE_FAKE_KEYBOARD
        bool "Diagnostics: act as a synthetic BLE keyboard instead of a bridge"
        default n
        help
            Turns the board into an advertiser that impersonates the AULA F99 Pro in pairing
            mode, byte for byte, and accepts connections. Nothing else runs - no HID host, no
            gamepad.

            What it is for: that keyboard pairs with the bridge on the C3 and S3 and never on
            the C6 or H2, and the difference was narrowed to the controller library, which is
            a prebuilt blob (AGENTS.md 4.35). This role replaces a device we cannot change
            with one we can, so the properties of the advertiser - interval, address type,
            discoverability flags - can be bisected against a failing initiator.

            Run it on a second board, with the real keyboard switched off so it cannot
            interfere.

    config APP_FAKE_KBD_ADV_ITVL_MS
        int "Synthetic keyboard: advertising interval in milliseconds"
        depends on APP_ROLE_FAKE_KEYBOARD
        range 20 10240
        default 200
        help
            The measured original advertises every 50-900 ms, so 200 ms sits in the middle of
            its range. Raise it to test whether a sparse advertiser is what the initiator
            struggles with.

    config APP_FAKE_KBD_RANDOM_ADDR
        bool "Synthetic keyboard: advertise from a static random address"
        depends on APP_ROLE_FAKE_KEYBOARD
        default y
        help
            The original uses a static random address (type 1). Turn this off to advertise
            from the public address instead - that is one of the bisection steps, because the
            initiator's address filtering is a suspect.

    config APP_FAKE_KBD_FLAGS
        hex "Synthetic keyboard: the AD flags byte"
        depends on APP_ROLE_FAKE_KEYBOARD
        default 0x05
        help
            0x05 is what the original sends: LE Limited Discoverable plus BR/EDR not
            supported. 0x06 swaps Limited for General Discoverable, which is what most
            devices use - worth trying, because Limited mode is the unusual choice here.

    config APP_FAKE_KBD_TX_POWER
        int "Synthetic keyboard: transmit power level index (15 = +20 dBm, 0 = -24 dBm)"
        depends on APP_ROLE_FAKE_KEYBOARD
        range 0 15
        default 15
        help
            Lets the synthetic keyboard be made quiet on purpose, which is the only way we
            have to simulate distance without moving hardware.

            Why it matters: the first run of this role connected on the H2 in 560 ms - but at
            rssi -7 dBm, because both boards sit on the same PCB. The real keyboard fails on
            the H2 at -40 dBm and succeeds on the S3 at -79 dBm. So the open question is
            whether the C6/H2 INITIATOR is deaf at distances where its SCANNER hears fine.
            Sweeping this value gives the rssi at which connecting stops working, which is a
            number, not a hypothesis.

            The index is esp_power_level_t: 15 = +20 dBm, 11 = +9 dBm, 8 = 0 dBm, 4 = -12 dBm,
            0 = -24 dBm.

    config APP_DEBUG_CTRL_LOG_DUMP
        bool "Diagnostics: dump the BLE controller's internal log after a failed open"
        default n
        help
            The C6/H2 controller keeps its own log, including the HCI traffic between host and
            controller, and can dump it on demand (esp_ble_controller_log_dump_all). With this
            option the bridge triggers that dump the moment a device open fails.

            Why: every conclusion about AGENTS.md 4.35 so far rests on "Connection failed;
            status=13", which is a HOST-side timeout and says nothing about what the
            controller did. The dump is the controller's own account of the same seconds.

            Needs the controller log compiled in, which is a separate set of options:
              CONFIG_BT_LE_CONTROLLER_LOG_ENABLED=y
              CONFIG_BT_LE_CONTROLLER_LOG_HCI_ENABLED=y     (default y)
              CONFIG_BT_LE_CONTROLLER_LOG_DUMP_ONLY=y       (default y, buffers in RAM)

            The intended use is a pair of runs on the SAME board: one dialling the real
            keyboard, which fails, and one dialling the synthetic keyboard from
            APP_ROLE_FAKE_KEYBOARD, which succeeds. The difference between the two dumps is
            the step where it goes wrong.

    config APP_DEBUG_SCAN_ONLY
        bool "Diagnostics: scan and log only, never connect to an input device"
        default n
        help
            The scanner normally stops as soon as it hears a usable candidate and hands the
            address to the connection path, which makes it impossible to measure what a
            device is actually doing in the air: how often it advertises, and how quickly it
            changes its address.

            With this option the bridge keeps scanning and only logs. Every advertising
            packet from a HID-looking device is printed with its address, RSSI, flags and raw
            payload, so a long run gives the advertising interval and the address rotation
            rate directly.

            Written to characterise the keyboard from AGENTS.md 4.35, whose advertising
            behaviour has to be reproduced by a synthetic advertiser before the difference
            between the C3/S3 and C6/H2 controllers can be bisected.

    config APP_DEBUG_WATCH_ADDR
        hex "Diagnostics: address guarded by a hardware watchpoint (0 = disabled)"
        default 0
        help
            When non-zero, the firmware arms a hardware write watchpoint on this address
            (4 bytes) at startup. On a write it panics with the backtrace of the CULPRIT
            rather than the victim - the only way to find out who is corrupting a static
            structure inside somebody else's component.

            Used to track down the crash in AGENTS.md 4.21. The address of the GAP
            connection-parameter update list head is read from the ELF file:

              riscv32-esp-elf-nm build.esp32c3/hid_gamepad_bridge.elf \\
                  | grep ble_gap_update_entries

            NOTE: the address changes between builds, so it must be re-read after every
            code change and checked for having moved.

endmenu
```
